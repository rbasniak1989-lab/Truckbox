## firmware/espidf/main/Kconfig.projbuild
```kconfig
menu "Truckbox B1"
choice TB_ROLE
    prompt "Device role"
    default TB_ROLE_CORE
config TB_ROLE_CORE
    bool "Core"
config TB_ROLE_LINK
    bool "Link"
endchoice
config TB_CORE_LITE
    bool "Rev.B.1 Core Lite (J1708 and local service)"
    depends on TB_ROLE_CORE
    select TB_J1708_ONLY
    help
        Decode the bus and serve the live cache without a local telemetry
        outbox, persistent trip checkpoint task or HTTP uplink bridge.
config TB_LINK_TELEMETRY_COLLECTOR
    bool "Rev.B.1 Link telemetry collector"
    depends on TB_ROLE_LINK
    help
        Poll the paired Core Lite and publish from a separate durable outbox.
        Official uploads require explicit per-device configuration.
config TB_CORE_WIFI_SHARING_REQUIRED
    bool
    default y if TB_ROLE_CORE
    select LWIP_IP_FORWARD
    select LWIP_IPV4_NAPT
    help
        Core AP internet sharing is part of the production contract. Select
        effective lwIP features even when an older sdkconfig disabled them.
config TB_J1708_ONLY
    bool "Rev.B.1 J1708_ONLY (no CAN acquisition resources)"
    depends on TB_ROLE_CORE
    default y
config TB_RAW_TCP
    bool "Legacy CAN RAW TCP35000 server"
    depends on TB_ROLE_CORE && !TB_J1708_ONLY
    default y
    help
        Legacy CAN profiles only. J1708_ONLY uses HTTP/Cloud and does not
        reserve the raw CAN queue, worker stack or TCP listening socket.
endmenu
```
