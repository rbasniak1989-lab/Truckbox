/* Catalog generated from the authoritative 76-row CSV; numeric mappings are
 * explicitly limited to repository evidence. See J1939_COVERAGE.csv. */
static const tbx_j1939_signal_t signals[TBX_J1939_SIGNAL_COUNT] = {
    { 1u, 61444u, "RPM", "rpm", "Android 61444/B3:B4: raw*0.125", TBX_J1939_LOG_VALIDATED, true, false, false },
    { 2u, 61444u, "Torque do motor", "%", "Android 61444/B2: raw-125", TBX_J1939_LOG_VALIDATED, true, false, false },
    { 3u, 61444u, "Potência estimada", "kW", "Android derived: max(torque_pct,0)*2643/100*rpm/9550; inventory calibration 2643 Nm", TBX_J1939_LOG_VALIDATED, true, false, true },
    { 4u, 61444u, "Demanda de torque", "", "No closed byte/scale in Master1.1, PythonV1 or Android; original inventory status retained", TBX_J1939_IN_VALIDATION, false, false, false },
    { 5u, 61444u, "Estado da partida", "", "No closed byte/scale in Master1.1, PythonV1 or Android; original inventory status retained", TBX_J1939_PENDING, false, false, false },
    { 6u, 61443u, "Acelerador", "%", "Android 61443/B1: raw*0.4", TBX_J1939_LOG_VALIDATED, true, false, false },
    { 7u, 61443u, "Interruptores do acelerador", "raw", "Master6.1 B0 low nibble; individual switch enum notclosed", TBX_J1939_LOG_VALIDATED, false, false, false },
    { 8u, 65247u, "Torque de atrito", "%", "Master6.15 B0-125", TBX_J1939_LOG_VALIDATED, true, false, false },
    { 9u, 65251u, "Torque de referência", "Nm", "Master6.17 B19:B20 LE; canonical2643Nm", TBX_J1939_LOG_VALIDATED, true, false, false },
    { 10u, 65251u, "Curva de torque", "curve", "Master6.17 five rpm/percent curvepoints B0..B14", TBX_J1939_LOG_VALIDATED, true, false, false },
    { 11u, 65251u, "Rotação máxima da configuração", "rpm", "Master6.17 highidle B15:B16 and extendedspeedupper B28:B29 *0.125", TBX_J1939_LOG_VALIDATED, true, false, false },
    { 12u, 65251u, "Limite de controle de torque", "%", "Master6.17 B26/B27 minus125 torquecontrollimits", TBX_J1939_LOG_VALIDATED, true, false, false },
    { 13u, 65251u, "Parâmetros avançados da programação", "raw", "Master6.17 Kp B21:B22 and B24/B25 raw; physicalscales unresolved", TBX_J1939_IN_VALIDATION, false, false, false },
    { 14u, 65265u, "Velocidade do caminhão", "km/h", "Android 65265/B1:B2: raw/256", TBX_J1939_LOG_VALIDATED, true, false, false },
    { 15u, 65265u, "Freio de estacionamento", "raw", "Master6.3 B0 raw; parkingbitmask nottranscribed", TBX_J1939_LOG_VALIDATED, false, false, false },
    { 16u, 65265u, "Velocidade programada no piloto", "km/h", "Master6.3 B5 cruisesetspeed km/h", TBX_J1939_LOG_VALIDATED, true, false, false },
    { 17u, 65217u, "Distância total em alta resolução", "km", "Android 65217/B0:B3: raw*0.005", TBX_J1939_LOG_VALIDATED, true, false, false },
    { 18u, 65217u, "Distância da viagem", "km", "Inventory and Android: differences of total distance; same source only", TBX_J1939_LOG_VALIDATED, true, false, true },
    { 19u, 65258u, "Peso nos eixos de tração", "kg", "Android 65258/1F or 2F redundant bogie: raw*0.5; never sum", TBX_J1939_LOG_VALIDATED, true, false, false },
    { 20u, 65258u, "Peso por canal do bogie", "kg", "Android 65258/B1:B2 channel 1F or 2F: raw*0.5", TBX_J1939_LOG_VALIDATED, true, false, false },
    { 21u, 65295u, "Peso estimado do conjunto", "kg", "Android Volvo 65295/B5: raw*1000, 10000..100000 kg estimate", TBX_J1939_LOG_VALIDATED, true, true, false },
    { 22u, 65295u, "Estado de movimento", "raw", "Master6.20 B0 proprietaryspeedstate raw; enum unknown", TBX_J1939_LOG_VALIDATED, false, true, false },
    { 23u, 65295u, "I-Roll (cópia auxiliar)", "bool", "Master6.20 B2 C0=inactive,C1=active secondaryIroll", TBX_J1939_LOG_VALIDATED, true, true, false },
    { 24u, 65262u, "Temperatura da água", "degC", "Android 65262/B0: raw-40", TBX_J1939_LOG_VALIDATED, true, false, false },
    { 25u, 65262u, "Temperatura do óleo do motor", "degC", "Android 65262/B2:B3: raw*0.03125-273", TBX_J1939_LOG_VALIDATED, true, false, false },
    { 26u, 65262u, "Temperatura do combustível", "degC", "Master6.8 B1-40; may mirrorcoolant; notindependent", TBX_J1939_IN_VALIDATION, true, false, false },
    { 27u, 65272u, "Temperatura do óleo da caixa", "degC", "Android 65272/B4:B5: raw*0.03125-273", TBX_J1939_LOG_VALIDATED, true, false, false },
    { 28u, 65269u, "Temperatura ambiente", "degC", "Android 65269/B3:B4: raw*0.03125-273", TBX_J1939_LOG_VALIDATED, true, false, false },
    { 29u, 65270u, "Pressão do turbo", "bar", "Android 65270/B1: raw*0.02 operational boost", TBX_J1939_LOG_VALIDATED, true, false, false },
    { 30u, 65270u, "Temperatura do ar de admissão", "degC", "Android 65270/B2: raw-40", TBX_J1939_LOG_VALIDATED, true, false, false },
    { 31u, 65270u, "Pressão de entrada do ar", "kPa abs", "Master6.6 B3*2 kPaabsolute", TBX_J1939_LOG_VALIDATED, true, false, false },
    { 32u, 65270u, "Restrição do filtro de ar", "kPa", "Master6.6 B4*0.05 kPa differential; nofilteralert", TBX_J1939_LOG_VALIDATED, true, false, false },
    { 33u, 65263u, "Pressão do combustível", "bar", "Android 65263/B0: raw*0.04", TBX_J1939_LOG_VALIDATED, true, false, false },
    { 34u, 65263u, "Pressão do óleo do motor", "bar", "Android 65263/B3: raw*0.04", TBX_J1939_LOG_VALIDATED, true, false, false },
    { 35u, 65263u, "Nível do óleo do motor", "%", "Android 65263/B2: raw*0.4", TBX_J1939_LOG_VALIDATED, true, false, false },
    { 36u, 65263u, "Pressão interna do cárter", "kPa", "Master6.5 B4:B5 LE /128-250 kPa", TBX_J1939_LOG_VALIDATED, true, false, false },
    { 37u, 65263u, "Nível da água do motor", "%", "Master6.5 B7*0.4; partial", TBX_J1939_IN_VALIDATION, true, false, false },
    { 38u, 65263u, "Pressão do arrefecimento", "", "No closed byte/scale in Master1.1, PythonV1 or Android; original inventory status retained", TBX_J1939_UNAVAILABLE, false, false, false },
    { 39u, 65263u, "Blow-by por campo auxiliar", "", "No closed byte/scale in Master1.1, PythonV1 or Android; original inventory status retained", TBX_J1939_UNAVAILABLE, false, false, false },
    { 40u, 61442u, "Rotação da entrada da caixa", "rpm", "Android 61442/B5:B6: raw*0.125", TBX_J1939_LOG_VALIDATED, true, false, false },
    { 41u, 61442u, "Rotação da saída da caixa", "rpm", "Android 61442/B1:B2: raw*0.125", TBX_J1939_LOG_VALIDATED, true, false, false },
    { 42u, 61442u, "Patinação da embreagem", "%", "Android 61442/B3: raw*0.4; inventory derived estimate", TBX_J1939_LOG_VALIDATED, true, false, true },
    { 43u, 61442u, "Estados internos da transmissão", "raw", "Master6.10 B0 ETC1raw; internalenum unknown", TBX_J1939_IN_VALIDATION, false, false, false },
    { 44u, 61445u, "Marcha selecionada", "gear", "Android 61445/B0: raw-125", TBX_J1939_LOG_VALIDATED, true, false, false },
    { 45u, 61445u, "Marcha engatada", "gear", "Android 61445/B3: raw-125", TBX_J1939_LOG_VALIDATED, true, false, false },
    { 46u, 61445u, "Relação de transmissão", "ratio", "Android 61445/B1:B2: raw*0.001", TBX_J1939_LOG_VALIDATED, true, false, false },
    { 47u, 65286u, "Modo da I-Shift", "enum", "Android Volvo 65286/B0: F2=N,F3=A,F4=M", TBX_J1939_LOG_VALIDATED, true, true, false },
    { 48u, 65286u, "Comandos de troca de marcha", "raw", "Master6.21/validation: rawVolvo payload; commandbitmapping absent", TBX_J1939_LOG_VALIDATED, false, true, false },
    { 49u, 65292u, "Marcha mais alta", "raw", "Master/validation: topgear functional but byte/enum absent", TBX_J1939_LOG_VALIDATED, false, true, false },
    { 50u, 65321u, "I-Roll ativo", "bool", "Android Volvo 65321: exact ASCII AN E+00 with leading space; only known active pattern", TBX_J1939_LOG_VALIDATED, true, true, false },
    { 51u, 65321u, "Modo econômico da I-Shift", "bool", "Master6.21 ASCII B4=E Economy", TBX_J1939_LOG_VALIDATED, true, true, false },
    { 52u, 65321u, "Marcha pelo sinal proprietário", "gear", "Master6.21 B2:B3 ASCII gear", TBX_J1939_LOG_VALIDATED, true, true, false },
    { 53u, 65321u, "Seletor da I-Shift (cópia)", "enum", "Master6.21 B1 ASCII A/M/N selector", TBX_J1939_LOG_VALIDATED, true, true, false },
    { 54u, 61440u, "Força do freio motor", "%", "Master6.12 B1-125 retarderpercent, negative braking", TBX_J1939_LOG_VALIDATED, true, false, false },
    { 55u, 65249u, "Curva de atuação do freio motor", "curve", "Master6.16/validation correctedretardercurve P1..P4 B2/5/8/11, P5rpm B14:B15, P5torque B18", TBX_J1939_LOG_VALIDATED, true, false, false },
    { 56u, 65249u, "Torque de referência do VEB", "raw", "Master6.16 B16:B17 raw reference930; no physicalscale", TBX_J1939_IN_VALIDATION, false, false, false },
    { 57u, 65323u, "Estágio selecionado do VEB", "enum", "Master6.22 B1 bits5..7 enum0off1auto2stage1 3stage2 4stage3", TBX_J1939_LOG_VALIDATED, true, true, false },
    { 58u, 65323u, "Estado auxiliar do VEB", "bool", "Master6.22 B2 CF=belowmax DF=maxstage", TBX_J1939_LOG_VALIDATED, true, true, false },
    { 59u, 65323u, "Piloto automático ligado", "bool", "Master6.22 B0 C7off DFon D7transition", TBX_J1939_LOG_VALIDATED, true, true, false },
    { 60u, 65323u, "Limite superior do cruise", "km/h", "Master6.22 B1bit0valid +B3 direct km/h; never manufacture cruise+5", TBX_J1939_LOG_VALIDATED, true, true, false },
    { 61u, 65323u, "Caminhão parado ou rodando", "bool", "Master6.22 B4 F7stationary F3moving", TBX_J1939_LOG_VALIDATED, true, true, false },
    { 62u, 65340u, "Botão + do piloto", "bool", "Master6.23 B6 D1 plus,C1normal,C5minus", TBX_J1939_LOG_VALIDATED, true, true, false },
    { 63u, 65340u, "Botão - do piloto", "bool", "Master6.23 B6 C5 minus,C1normal,D1plus", TBX_J1939_LOG_VALIDATED, true, true, false },
    { 64u, 61441u, "ABS atuando", "raw", "Master6.13/validation B0raw; ABSbitmask notclosed", TBX_J1939_LOG_VALIDATED, false, false, false },
    { 65u, 61441u, "Aviso de ABS/EBS", "raw", "Master6.13/validation B5raw; warningbitmask notclosed", TBX_J1939_LOG_VALIDATED, false, false, false },
    { 66u, 65132u, "Veículo em movimento pelo tacógrafo", "bool", "Master6.14 B0bits6..7 state0stationary1moving", TBX_J1939_LOG_VALIDATED, true, false, false },
    { 67u, 65132u, "Estado de trabalho do motorista", "raw", "Master6.14 B0bits0..2 driverraw; enum incompletelyclosed", TBX_J1939_IN_VALIDATION, false, false, false },
    { 68u, 65132u, "Rotação da saída pelo tacógrafo", "rpm", "Master6.14 B4:B5 LE*0.125", TBX_J1939_LOG_VALIDATED, true, false, false },
    { 69u, 65132u, "Velocidade pelo tacógrafo", "km/h", "Master6.14 B6:B7 LE/256", TBX_J1939_LOG_VALIDATED, true, false, false },
    { 70u, 65254u, "Data e hora do caminhão", "calendar_local", "Master6.18 calendar quarterseconds/quarterdays; rawlocaloffsets notUTC", TBX_J1939_LOG_VALIDATED, true, false, false },
    { 71u, 65282u, "Acelerador, velocidade e piloto (cópia)", "raw", "Master/validation aggregatorraw; nobyte mapping closed", TBX_J1939_LOG_VALIDATED, false, true, false },
    { 72u, 65317u, "Farol baixo", "raw", "Master6.24 B1 D0 probablelowbeam; no physicalassertion", TBX_J1939_IN_VALIDATION, false, true, false },
    { 73u, 65317u, "Farol alto", "raw", "Master6.24 B1 D2 probablehighbeam; no physicalassertion", TBX_J1939_IN_VALIDATION, false, true, false },
    { 74u, 65317u, "Comandos auxiliares de iluminação", "raw", "Master6.24 B0 rawauxiliarycommands 44/50/60; namesunknown", TBX_J1939_PENDING, false, true, false },
    { 75u, 65110u, "Sinais do sistema SCR/ARLA", "", "No closed byte/scale in Master1.1, PythonV1 or Android; original inventory status retained", TBX_J1939_UNAVAILABLE, false, false, false },
    { 76u, 65320u, "Mensagem Volvo ainda desconhecida", "", "No closed byte/scale in Master1.1, PythonV1 or Android; original inventory status retained", TBX_J1939_UNDECODED, false, true, false },
};
